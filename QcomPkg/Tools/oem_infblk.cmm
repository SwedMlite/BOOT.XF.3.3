entry
 ; &InfoBlkPtrOffset=0x00410000
enddo


