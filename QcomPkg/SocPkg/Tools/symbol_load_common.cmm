;============================================================================
;  Name:
;    symbol_load.cmm
;
;  Description:
;     Loads UEFI symbols, after halting target
;
; Copyright (c) 2012-2019 Qualcomm Technologies, Inc.
; All Rights Reserved.
; Qualcomm Technologies Proprietary and Confidential.
;
;----------------------------------------------------------------------------
;============================================================================
;
;                        EDIT HISTORY FOR MODULE
;
;
;
; when         who     what, where, why
; ----------   ---     ----------------------------------------------------------
; 2018-07-02   kpa     Added TargetPkgPath argument
; 2017-09-12   vk      Remove PATH
; 2016-07-21   bh      Support SDM845
; 2013-03-12   vk      Initial version
;============================================================================;
area.clear
area.reset
area.create UEFI_Logs 1000. 8192.
area.select UEFI_Logs

global &UefiBase

local &SecAddr
local &CwDir
local &RunOption
local &MenuScriptsPath
;
;  If this common script is invoked directly, pass TargetPkgPath argument
;  to correctly set T32 Toolbar Menu button scripts
;  TargetPkgPath is not mandatory. If not supplied script will still load
;  symbols. Only T32 menu buttons might not work.

ENTRY &TargetPkgPath &Option
  &CwDir=os.ppd()
  &TmpDir=os.ptd()
  &RunOption=0x0
  &CommonTools="&CwDir/../../Tools"

  &UefiBase=0x9FC00000

  if (("&TargetPkgPath"=="INCR")||("&Option"=="INCR"))
  (
    &RunOption=0x1
    do &CommonTools/sym.cmm &UefiBase &RunOption
    enddo
  )

  &MenuScriptsPath="&CwDir"
  if ("&TargetPkgPath"!="")
  (
    &MenuScriptsPath="&TargetPkgPath"
  )
  else
  (
    print " Warning: TargetPkgPath not provided. Menu buttons might not work."
  )
  y.reset

  if (interface.sim()==FALSE())
  (
    sys.m.a
  )

  if run()
  (
    break
  )

  ;Setup windows
  if (os.file("&TmpDir/win.cmm"))
  (
    do &TmpDir/win.cmm
  )
  else
  (
    do &CommonTools/win.cmm
  )

  ;Load T32 UEFI awareness

  do &CommonTools/cmm/t32_uefi_menu.cmm &MenuScriptsPath

  do &CommonTools/InitOffsets.cmm
  do &CommonTools/load_sec_sym.cmm &UefiBase &UefiBase+&SecLoadAddrOffset
  do &CommonTools/sym.cmm &UefiBase &RunOption

  cd &CwDir
enddo


